## tests/fixtures/components/cmp_kconfig_rules_stale_sdkconfig/main/Kconfig.projbuild
```kconfig
menu "Component Manager Kconfig rules reproduction"

    choice REPRO_COMPONENT
        prompt "Selected local component"
        default REPRO_COMPONENT_A

        config REPRO_COMPONENT_A
            bool "Component A"

        config REPRO_COMPONENT_B
            bool "Component B"
    endchoice

endmenu
```
