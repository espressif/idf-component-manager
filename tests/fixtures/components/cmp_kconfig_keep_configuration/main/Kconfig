## tests/fixtures/components/cmp_kconfig_keep_configuration/main/Kconfig
```kconfig
config ESP_BOARD_DEV_CAMERA_SUPPORT
    bool "Enable camera support"
    default y
```

## tests/fixtures/components/cmp_with_kconfig_var/cmp/Kconfig.in
```kconfig
menu "Device Support"

config ESP_BOARD_DEV_AUDIO_CODEC_SUPPORT
    bool "Device 'audio_codec' support"
    default y
    help
        Enable audio_codec device support.
        This option enables the audio_codec device driver.
        The driver is located at: devices/dev_audio_codec

endmenu
```
